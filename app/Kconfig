## app/Kconfig
```kconfig
menu "本地 OTA"

config LOCAL_OTA_HTTP_PACKAGE_URL
    string "本地 OTA 固件 URL"
    default "http://192.168.31.12:8080/hello_world.bin"
    help
        可由 ESP32 在局域网访问的完整固件 URL。检查时 HTTP 返回 200 且
        Content-Length 大于 0 即视为存在更新包。

config LOCAL_OTA_HTTP_TIMEOUT_MS
    int "HTTP 下载超时（毫秒）"
    default 15000
    range 1000 120000

endmenu
```

## app/Kconfig.projbuild
```kconfig
menu "MQTT 测试"

config MQTT_TEST_BROKER_URI
    string "MQTT Broker URI"
    default "mqtt://192.168.1.100:1883"
    help
        MQTT Broker 地址，例如 mqtt://192.168.1.100:1883。
        请替换为运行 Mosquitto、EMQX 等 Broker 的电脑在局域网中的 IPv4 地址。

config MQTT_TEST_TOPIC
    string "遥测上报主题"
    default "esp32s3/test/telemetry"

config MQTT_TEST_CLIENT_ID
    string "MQTT 客户端 ID"
    default "esp32s3-mqtt-test"
    help
        同一 Broker 上每台设备必须使用不同的客户端 ID。

endmenu

menu "和风天气"

config WEATHER_QWEATHER_HOST
    string "和风天气私有 API Host"
    default ""

config WEATHER_QWEATHER_API_KEY
    string "和风天气 API Key"
    default ""

config WEATHER_DEFAULT_CITY
    string "默认城市（英文）"
    default "Shenzhen"

config WEATHER_DEFAULT_LOCATION_ID
    string "默认城市 LocationID"
    default "101280601"

config WEATHER_REFRESH_MINUTES
    int "实时天气刷新间隔（分钟）"
    range 5 1440
    default 30

config WEATHER_AUTO_LOCATION
    bool "启用公网 IP 自动定位"
    default n
    help
        启用后每次天气刷新前会使用 HTTPS IP 定位并调用和风 GeoAPI 反查城市。

config WEATHER_IP_GEO_URL
    string "主 IP 定位服务 URL"
    default "https://ipinfo.io/json"
    depends on WEATHER_AUTO_LOCATION

endmenu
```

## sdkconfig.defaults
```kconfig
CONFIG_FREERTOS_GENERATE_RUN_TIME_STATS=y
CONFIG_FREERTOS_RUN_TIME_STATS_USING_ESP_TIMER=y
CONFIG_GPTIMER_CTRL_FUNC_IN_IRAM=y
CONFIG_GPTIMER_ISR_IRAM_SAFE=y
CONFIG_ESPTOOLPY_FLASHSIZE_8MB=y
CONFIG_PARTITION_TABLE_CUSTOM=y
CONFIG_PARTITION_TABLE_CUSTOM_FILENAME="partitions.csv"
CONFIG_SPIRAM=y
CONFIG_SPIRAM_MODE_QUAD=y
# CONFIG_SPIRAM_MODE_OCT is not set
CONFIG_SPIRAM_TYPE_AUTO=y
CONFIG_SPIRAM_SPEED_40M=y
CONFIG_SPIRAM_SPEED=40
CONFIG_SPIRAM_BOOT_INIT=y
# CONFIG_SPIRAM_IGNORE_NOTFOUND is not set
CONFIG_SPIRAM_USE_CAPS_ALLOC=y
# CONFIG_SPIRAM_USE_MALLOC is not set
CONFIG_SPIRAM_MEMTEST=y
```
